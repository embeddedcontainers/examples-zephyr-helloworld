## west.yml
```yaml
manifest:
  self:
    west-commands: scripts/west-commands.yml
    path: app

  remotes:
    - name: zephyrproject-rtos
      url-base: https://github.com/zephyrproject-rtos

  projects:
    - name: zephyr
      remote: zephyrproject-rtos
      revision: main
      import:
        path-prefix: deps
        name-allowlist:
          - zephyr
          - cmsis_6
          - hal_stm32
```
